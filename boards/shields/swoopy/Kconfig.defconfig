## boards/shields/swoopy/Kconfig.defconfig
```kconfig
if SHIELD_SWOOPY_LEFT

config ZMK_KEYBOARD_NAME
    default "Swoopy Left"

endif

if SHIELD_SWOOPY_RIGHT

config ZMK_KEYBOARD_NAME
    default "Swoopy Right"

endif
```
