#include "swoopy.dtsi"

/ {
    sensors: sensors {
        compatible = "zmk,keymap-sensors";
        sensors = <&left_encoder>;
        triggers-per-rotation = <5>;
    };
};

&left_encoder {
    status = "okay";
};